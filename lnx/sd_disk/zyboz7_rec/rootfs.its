## lnx/sd_disk/zyboz7_rec/rootfs.its
```
/dts-v1/;

/ {
    description = "U-Boot fitImage for zynq7";
    #address-cells = <1>;

    images {
        kernel-1 {
            description = "Linux kernel";
            data = /incbin/("./build/zImage");
            type = "kernel";
            arch = "arm";
            os = "linux";
            compression = "none";
            load = <0x8000>;
            entry = <0x8000>;
            hash-1 {
                algo = "sha256";
            };
        };

        fdt-1 {
            description = "Flattened Device Tree blob";
            data = /incbin/("./build/system.dtb");
            type = "flat_dt";
            arch = "arm";
            compression = "none";
            hash-1 {
                algo = "sha256";
            };
        };
    };

    configurations {
        default = "conf-1";
        conf-1 {
            description = "Boot Linux kernel, FDT blob";
            kernel = "kernel-1";
            fdt = "fdt-1";
            hash-1 {
                algo = "sha256";
            };
        };
    };
};
```
